## test/menuconfig/kconfigs/Kconfig.float
```kconfig
mainmenu "Test kconfig float"

    config FLOAT_VALUE
        float "Float value"
        range 0.5 2.5
        default 1.0
```

## test/menuconfig/kconfigs/Kconfig.indirect_sets
```kconfig
mainmenu "Test set and set default options"

    config SET_SOURCE
        bool "Set option source"
        default y
        set SET_TARGET=4

    config SET_TARGET
        int "Set option target"
        default 0

    config SET_DEFAULT_SOURCE
        bool "Set default option source"
        default y
        set default SET_DEFAULT_TARGET=4

    config SET_DEFAULT_TARGET
        int "Set default option target"
        default 0
```

## test/menuconfig/kconfigs/Kconfig.pilot_all_scalars
```kconfig
mainmenu "Pilot smoke test"

    config BOOL_SYM
        bool "A bool"
        default y

    config INT_SYM
        int "An int"
        range 0 10
        default 1

    config HEX_SYM
        hex "A hex"
        default 0x10

    config STRING_SYM
        string "A string"
        default "hello"

    config FLOAT_SYM
        float "A float"
        default 1.0
```

## test/menuconfig/kconfigs/Kconfig.pilot_choice
```kconfig
mainmenu "Pilot choice fixture"

    choice
        prompt "Pick one"
        default OPTION_A

        config OPTION_A
            bool "Option A"

        config OPTION_B
            bool "Option B"
    endchoice
```

## test/menuconfig/kconfigs/Kconfig.pilot_submenu
```kconfig
mainmenu "Pilot submenu fixture"

    config TOP_BOOL
        bool "Top-level bool"
        default y

    menu "Inner menu"
        config INNER_BOOL
            bool "Inner bool"
            default n
    endmenu
```

## test/menuconfig/kconfigs/Kconfig.warning
```kconfig
mainmenu "Kconfig serving for testing the warning option"

    config RISKY_BOOL
        bool "User setting this bool is risky"
        default n
        warning "Risky bool!"

    config RISKY_INT
        int "User setting this string is risky"
        default 0
        warning "Risky int!"

    config ALREADY_USER_SET_RISKY_INT
        int "This risky config is already user-set"
        default 0
        warning "This symbol will be already set!"
        help
            This config option is user-set in sdkconfig.warning.
            Because of that, further editing by the user should NOT produce
            the warning about setting risky feature.
            However, after resetting the value by R-key, the dialog should be printed
            again.
```
