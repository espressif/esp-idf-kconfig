## test/kcompare/fixtures/cwd_trap/Kconfig
```kconfig
mainmenu "Trap"

config IDF_EXPERIMENTAL_FEATURES
    bool
    default n

config TRAP_ONLY
    bool
    default y
```

## test/kcompare/fixtures/idf_newer/Kconfig
```kconfig
mainmenu "Dummy ESP-IDF Configuration (newer)"

source "$COMPONENT_KCONFIGS_PROJBUILD_SOURCE_FILE"

menu "Component config"
    source "$COMPONENT_KCONFIGS_SOURCE_FILE"
endmenu
```

## test/kcompare/fixtures/idf_newer/components/foo/Kconfig
```kconfig
config SRC
    bool "src"
    default y
    select TGT

config TGT
    bool "tgt"
    default n

config VAL
    int "val"
    default 1 if SRC
    default 2

config FOO
    bool
    default n

config ADDED
    bool
    default y

config GONE_NEW
    bool
    default n

config IDF_EXPERIMENTAL_FEATURES
    bool
    default y

choice MYCHOICE
    bool "choice"
    default OPT_B

    config OPT_A
        bool "A"
    config OPT_B
        bool "B"
endchoice
```

## test/kcompare/fixtures/idf_older/Kconfig
```kconfig
mainmenu "Dummy ESP-IDF Configuration (older)"

source "$COMPONENT_KCONFIGS_PROJBUILD_SOURCE_FILE"

menu "Component config"
    source "$COMPONENT_KCONFIGS_SOURCE_FILE"
endmenu
```

## test/kcompare/fixtures/idf_older/components/foo/Kconfig
```kconfig
config SRC
    bool "src"
    default y
    select TGT

config TGT
    bool "tgt"
    default n

config VAL
    int "val"
    default 1 if SRC
    default 2

config FOO
    bool
    default y

config GONE
    bool
    default n

config IDF_EXPERIMENTAL_FEATURES
    bool
    default n

choice MYCHOICE
    bool "choice"
    default OPT_A

    config OPT_A
        bool "A"
    config OPT_B
        bool "B"
endchoice
```

## test/kconfiglib/kconfigs/Kconfig.conditional_prompt
```kconfig
mainmenu "Conditional Prompt Test"

    config GATE
        bool
        default n

    config TYPE_IF_GATE_FALSE
        bool "Prompt only when GATE" if GATE
        default y

    config TYPE_IF_GATE_TRUE
        bool "Prompt only when TYPE_IF_GATE_FALSE" if TYPE_IF_GATE_FALSE
        default y

    config EXPLICIT_IF_GATE_FALSE
        bool
        prompt "Explicit prompt only when GATE" if GATE
        default y

    config EXPLICIT_IF_GATE_TRUE
        bool
        prompt "Explicit prompt only when TYPE_IF_GATE_FALSE" if TYPE_IF_GATE_FALSE
        default y
```

## test/kconfiglib/kconfigs/Kconfig.dollar_expansion
```kconfig
mainmenu "Dollar expansion test"

config EMBEDDED
    string
    default "/p/$DOLLAR_TEST_VAR/x"

config LEADING
    string
    default "$DOLLAR_TEST_VAR/x"

config PAREN
    string
    default "$(DOLLAR_TEST_VAR)/x"

config BRACE
    string
    default "${DOLLAR_TEST_VAR}/x"
```

## test/kconfiglib/kconfigs/Kconfig.lowercase_symbols
```kconfig
mainmenu "Lowercase symbol names test"

config lower_gate
    bool "Lowercase gate"
    default y

config UPPER_DEPENDENT
    bool "Depends on lowercase symbol"
    depends on lower_gate
    default y
```

## test/kconfiglib/kconfigs/Kconfig.sdkconfig_inline_comment
```kconfig
# See sdkconfig.sdkconfig_inline_comment for details
mainmenu "Test sdkconfig inline comment handling"

    config INT_CONFIG
        int "int config"
        default 100

    config STRING_CONFIG
        string "string config"
        default "unused"
```

## test/kconfiglib/kconfigs/Kconfig.set_edge_cases
```kconfig
mainmenu "Test edge cases of set and set default options"

    config VALUE_INT
        int "Value outside of the target range"
        default 100

    config APPLY_SET
        bool "Apply set options"
        default y
        set STR_TARGET=""
        set INT_TARGET=VALUE_INT
        set HEX_TARGET=0x100
        set FLOAT_TARGET=10.5

    config APPLY_SET_DEFAULT
        bool "Apply set default options"
        default y
        set default WEAK_STR_TARGET=""
        set default WEAK_INT_TARGET=VALUE_INT
        set default WEAK_HEX_TARGET=0x100
        set default WEAK_FLOAT_TARGET=10.5

    config STR_TARGET
        string "String target"
        default "default"

    config WEAK_STR_TARGET
        string "Weak string target"
        default "default"

    config INT_TARGET
        int "Int target"
        range 0 10
        default 5

    config WEAK_INT_TARGET
        int "Weak int target"
        range 0 10
        default 5

    config HEX_TARGET
        hex "Hex target"
        range 0x0 0x10
        default 0x5

    config WEAK_HEX_TARGET
        hex "Weak hex target"
        range 0x0 0x10
        default 0x5

    config FLOAT_TARGET
        float "Float target"
        range 0.0 1.5
        default 0.5

    config WEAK_FLOAT_TARGET
        float "Weak float target"
        range 0.0 1.5
        default 0.5
```

## test/kconfiglib/kconfigs/Kconfig.set_unavailable_source
```kconfig
mainmenu "Test set and set default with a symbol value whose dependencies are not satisfied"

    config SRC_ENABLED
        bool "Enable source symbols"
        default y

    config SRC_INT
        int "src int"
        depends on SRC_ENABLED
        default 22

    config SRC_HEX
        hex "src hex"
        depends on SRC_ENABLED
        default 0x16

    config SRC_FLOAT
        float "src float"
        depends on SRC_ENABLED
        default 2.5

    config SRC_STR
        string "src str"
        depends on SRC_ENABLED
        default "src"

    config APPLY_SET
        bool
        default y
        set DST_INT=SRC_INT
        set DST_HEX=SRC_HEX
        set DST_FLOAT=SRC_FLOAT
        set DST_STR=SRC_STR
        set NEXT_DST_INT=SRC_INT
        set NEXT_DST_INT=99

    config APPLY_SET_DEFAULT
        bool
        default y
        set default WEAK_DST_INT=SRC_INT
        set default WEAK_DST_HEX=SRC_HEX
        set default WEAK_DST_FLOAT=SRC_FLOAT
        set default WEAK_DST_STR=SRC_STR

    config DST_INT
        int "dst int"
        default 7

    config DST_HEX
        hex "dst hex"
        default 0x7

    config DST_FLOAT
        float "dst float"
        default 1.0

    config DST_STR
        string "dst str"
        default "dst"

    config NEXT_DST_INT
        int "next dst int"
        default 7

    config WEAK_DST_INT
        int "weak dst int"
        default 7

    config WEAK_DST_HEX
        hex "weak dst hex"
        default 0x7

    config WEAK_DST_FLOAT
        float "weak dst float"
        default 1.0

    config WEAK_DST_STR
        string "weak dst str"
        default "dst"
```

## test/kconfiglib/kconfigs/Kconfig.unnamed_choices
```kconfig
mainmenu "Unnamed choices test"

choice
    bool "Pick color"
    default COLOR_RED

    config COLOR_RED
        bool "Red"
    config COLOR_BLUE
        bool "Blue"
endchoice

choice
    bool "Pick size"
    default SIZE_SMALL

    config SIZE_SMALL
        bool "Small"
    config SIZE_BIG
        bool "Big"
endchoice
```

## test/menuconfig/kconfigs/Kconfig.indirect_sets_inactive
```kconfig
mainmenu "Test menuconfig output for set and set default options which do not take effect"

    config VALUE_ENABLED
        bool "Enable the unavailable value"
        default n

    config UNAVAILABLE_VALUE
        int "Value which is unavailable by default"
        depends on VALUE_ENABLED
        default 5

    config AVAILABLE_VALUE
        int "Value which is always available"
        default 9

    config FIRST_SOURCE
        bool "First set option source"
        default y
        set DST_SKIPPED=UNAVAILABLE_VALUE
        set DST_FALLTHROUGH=UNAVAILABLE_VALUE

    config SECOND_SOURCE
        bool "Second set option source"
        default y
        set DST_FALLTHROUGH=AVAILABLE_VALUE

    config TARGET_DEPS_ENABLED
        bool "Enable dependencies of the set default target"
        default n

    config SET_DEFAULT_SOURCE
        bool "Set default option source"
        default y
        set default DST_DEPS_UNMET=3

    config DST_SKIPPED
        int "Target of a set option with unavailable value"
        default 7

    config DST_FALLTHROUGH
        int "Target of an unavailable and an available set option"
        default 7

    config DST_DEPS_UNMET
        int "Target of a set default option with unmet dependencies"
        depends on TARGET_DEPS_ENABLED
        default 7

    config BOTH_SOURCE
        bool "Source of set options which all apply"
        default y
        set DST_TWO_SETS=1
        set DST_TWO_SETS=2
        set default DST_USER_SET=3

    config DST_TWO_SETS
        int "Target of two set options which both apply"
        default 7

    config DST_USER_SET
        int "Target of a set default option which can be overridden by the user"
        default 7
```

## test/menuconfig/kconfigs/Kconfig.indirect_sets_symbol
```kconfig
mainmenu "Test set and set default options with a symbol as the value"

    config VALUE_SOURCE
        int "Value source"
        default 22

    config SET_SOURCE
        bool "Set option source"
        default y
        set SET_TARGET=VALUE_SOURCE
        set default SET_DEFAULT_TARGET=VALUE_SOURCE

    config SET_TARGET
        int "Set option target"
        default 0

    config SET_DEFAULT_TARGET
        int "Set default option target"
        default 0
```

## test/menuconfig/kconfigs/Kconfig.mismatch_dep
```kconfig
mainmenu "Mismatch list dependency test"

config A
    bool "A"
    default n

config B
    int "B"
    default 1
    depends on A

menu "S"

config C
    int "C"
    default 1
    depends on A

endmenu
```

## test/menuconfig/kconfigs/Kconfig.pilot_brackets
```kconfig
mainmenu "Bracket rendering test"

    config BRACKET_BOOL
        bool "Enable [experimental] mode"
        default y
        help
            Uses [square] brackets and a [/] closing-like tag in help text.

    menu "Menu [beta]"
        config INNER_BOOL
            bool "inner"
    endmenu
```

## test/menuconfig/kconfigs/Kconfig.pilot_mismatch
```kconfig
mainmenu "Mismatch list test"

config FOO
    int "Foo"
    default 1

choice PICK
    bool "Pick"
    default CA

    config CA
        bool "Alpha"
    config CB
        bool "Beta"
endchoice
```
