## test/kconfcheck/Kconfig
```kconfig
mainmenu "Kconfig for kconfcheck"

    # Should trigger "only files named Kconfig.* can be sourced".
    source "some/nonexistent/file"
```

## test/kconfcheck/sdkconfigs/check_deprecated/sdkconfig.defaults.with_deprecated
```kconfig
CONFIG_UNRELATED="this option is unrelated and should not have any effect to the test"
CONFIG_OLD_NAME=y
```

## test/kconfcheck/sdkconfigs/check_deprecated/sdkconfig.defaults.without_deprecated
```kconfig
CONFIG_NEW_NAME=y
CONFIG_UNRELATED="this option is unrelated and should not have any effect to the test"
```

## test/kconfiglib/deprecated/Kconfig
```kconfig
mainmenu "Test deprecated options"

config FEATURE_ENABLE
    bool "Enable feature"
    default y

config FEATURE_SPEED
    int "Feature speed"
    default 100

config FEATURE_NAME
    string "Feature name"
    default "default_name"

config FEATURE_ADDR
    hex "Feature address"
    default 0xFF

config FEATURE_DISABLE
    bool "Disable feature"
    default n

config ANOTHER_BOOL
    bool "Another boolean"
    default y
```

## test/kconfiglib/kconfigs/Kconfig.choice_loading
```kconfig
mainmenu "Test if choice values are correctly loaded and evaluated in case of problems"

    choice TEST_CHOICE
        prompt "Choice for load testing"
        default ALPHA

        config ALPHA
            bool "Alpha"

        config BETA
            bool "Beta"

        config GAMMA
            bool "Gamma"

    endchoice
```

## test/kconfiglib/kconfigs/Kconfig.choice_non_first_default
```kconfig
mainmenu "Test if choice having non first config default is parsed correctly"

    choice DEFAULT_SELECTION_NOT_FIRST
        prompt "Choice which has its default selection different from the first symbol"
        default BETA

        config ALPHA
            bool "Alpha"

        config BETA
            bool "Beta"

        config GAMMA
            bool "Gamma"

    endchoice
```

## test/kconfiglib/kconfigs/Kconfig.choices
```kconfig
mainmenu "Kconfig for testing choices"

choice CHOICE
    prompt "Prompt for test choice"

    config FIRST
        bool "FIRST"

    config SECOND
        bool "SECOND"

    config THIRD
        bool "THIRD"

endchoice


# Use case below tests a situation when choice is deselected by its dependency

config DEPENDEE
    bool "Symbol enables/disables DEPENDENT_CHOICE"
    default n

choice DEPENDENT_CHOICE
    prompt "This choice is dependent on DEPENDEE symbol"
    depends on DEPENDEE

    config DEPENDENT_FIRST
        bool "DEPENDENT_FIRST"

    config DEPENDENT_SECOND
        bool "DEPENDENT_SECOND"

endchoice

# This choice's selection will be improperly changed in sdkconfig.unselect_selected_symbol

choice SELECTING_SYMBOL
    bool "choice testing improper change of selected symbol"

    config THIS_IS_SELECTED_BY_DEFAULT
        bool "This symbol is selected by default"

    config THIS_IS_SELECTED_IN_SDKCONFIG
        bool "This symbol will be selected in sdkconfig"

endchoice
```

## test/kconfiglib/kconfigs/Kconfig.default_pragma_regression
```kconfig
# See sdkconfig.default_pragma_regression for details
mainmenu "Test default pragma regression"

    config PRAGMA_TEST
        bool "Pragma test"
        default n
```

## test/kconfiglib/kconfigs/Kconfig.default_validity
```kconfig
mainmenu "Test validity of injected value"

# This Kconfig is outside ok/warning/error folders because it is used with load_config -> different workflow

    config INT_CONFIG
        int "Int config"
        default 1

    config BOOL_CONFIG
        bool "Bool config"
        default y

    config STRING_CONFIG
        string "String config"
        default "string"

    config HEX_CONFIG
        hex "Hex config"
        default 0x42

    config FLOAT_CONFIG
        float "Float config"
        default 1.5
```

## test/kconfiglib/kconfigs/Kconfig.deprecated_vals
```kconfig
mainmenu "Test if deprecated configs are loaded correctly"

    config NEW_BOOL
        bool "New boolean option"
        default y

    config NEW_STRING
        string "New string option"
        default "test"

    config NEW_HEX
        hex "New hex option"
        default 0xbeef

    config NEW_INT
        int "New int option"
        default 42

    config NEW_BOOL_INVERTED
        bool "New boolean inverted option (old should be inverted)"
        default y
```

## test/kconfiglib/kconfigs/Kconfig.disabled_symbols_choices
```kconfig
mainmenu "Disabled Symbols and Choices"

    config ENABLE_FEATURE
        bool "Enable feature"
        default n

    config DISABLED_SYMBOL
        bool "Disabled symbol"
        depends on ENABLE_FEATURE
        default n

    config DISABLED_INT
        int "Disabled integer"
        depends on ENABLE_FEATURE
        default 0

    choice DISABLED_CHOICE
        prompt "Disabled choice"
        depends on ENABLE_FEATURE
        default CHOICE_A

        config CHOICE_A
            bool "Choice A"

        config CHOICE_B
            bool "Choice B"

    endchoice

    menu "Disabled menu"
        visible if ENABLE_FEATURE

        config INSIDE_MENU
            string "String inside disabled menu"
            default "hello"

    endmenu
```

## test/kconfiglib/kconfigs/Kconfig.idf_min_config
```kconfig
mainmenu "Test IDF minimal config"

    config IDF_TARGET
        string "IDF target"
        default "esp32"

    config MOTORS_ENABLED
        bool "Motors enabled"
        default n

    config CREW
        bool "Crew"
        default n

    config FUEL
        string "Fuel"
        default "kerosene"
```

## test/kconfiglib/kconfigs/Kconfig.idf_min_config_labels
```kconfig
mainmenu "Test IDF minimal config with labels"

    config IDF_TARGET
        string "IDF target"
        default "esp32"

    menu "Engine"
        config MOTORS_ENABLED
            bool "Motors enabled"
            default n

        config FUEL
            string "Fuel"
            default "kerosene"

        menu "Advanced"
            config TURBO
                bool "Turbo"
                default n
        endmenu
    endmenu

    menu "Navigation"
        config GPS
            bool "GPS"
            default y

        config COMPASS
            bool "Compass"
            default y
    endmenu
```

## test/kconfiglib/kconfigs/Kconfig.inversed_dep_order_1
```kconfig
mainmenu "Test defaults mismatch if dependent sym is defined before dependee"

config DEPENDENT_0
    string "This is a dependent symbol"
    default "str_1" if FREE_0=1
    default "str_2" if FREE_0=2
    default "fallback"

config FREE_0
    int "free/independent symbol"
    default 1

config DEPENDENT_1
    string "This is a dependent symbol"
    default "str_1" if FREE_1=1
    default "str_2" if FREE_1=2
    default "fallback"

config FREE_1
    int "free/independent symbol"
    default 1

# currently selected config option becomes invisible
# NOTE: in this case, we cannot hold to the sdkconfig value no matter the policy!
# CH_1_1 should be selected after loading the sdkconfig and warnings should be issued
choice CHOICE_1
    bool "Test choice"
    default CH_1_3

    config CH_1_1
        bool "Choice option 1"
    config CH_1_2
        bool "Choice option 2"
    config CH_1_3
        bool "Choice option 3"
        depends on FREE_2
endchoice

config FREE_2
    bool "free/independent symbol"
    default y

choice CHOICE_2
    bool "Test choice"
    default CH_2_3 if FREE_3=3
    default CH_2_2 if FREE_3=2

    config CH_2_1
        bool "Choice option 1"
    config CH_2_2
        bool "Choice option 2"
    config CH_2_3
        bool "Choice option 3"
endchoice

config FREE_3
    int "free/independent symbol"
    default 3

config DEPENDENT_ON_CHOICE
    string "Symbol dependent on choice"
    default "str_1" if CH_FREE_1
    default "str_2" if CH_FREE_2
    default "fallback"

choice CHOICE_FREE
    bool "Test choice"

    config CH_FREE_1
        bool "Choice option 1"
    config CH_FREE_2
        bool "Choice option 2"
    config CH_FREE_3
        bool "Choice option 3"
endchoice
```

## test/kconfiglib/kconfigs/Kconfig.invisible_choice_all_n
```kconfig
mainmenu "Test"

config NOT
    bool "prompt"
    default n

if NOT
    choice CHOICE
        prompt "Choice"

    config SYM
        bool "Sym"

    config SYM2
        bool "Sym2"

    endchoice
endif
```

## test/kconfiglib/kconfigs/Kconfig.loading_defaults
```kconfig
mainmenu "Test kconfig"

  config DEPENDEE
         bool "Dependee"
         default y

    config DEP
        int "Int dependency"
        default 0 if !DEPENDEE
        default 1 if DEPENDEE

    config PROMPTLESS_Y
        bool
        default y

    config PROMPTLESS_N
        bool
        default n
```

## test/kconfiglib/kconfigs/Kconfig.multiple_definition_report
```kconfig
mainmenu "Multiple symbol and choice definitions for report test"

config DUP_SYMBOL
    int "First DUP_SYMBOL"
    default 1

config DUP_SYMBOL
    int "Second DUP_SYMBOL"
    default 2

choice DUP_CHOICE
    prompt "First DUP_CHOICE"

    config DUP_CHOICE_A
        bool "option a"
    config DUP_CHOICE_B
        bool "option b"
endchoice

choice DUP_CHOICE
    prompt "Second DUP_CHOICE"

    config DUP_CHOICE_C
        bool "option c"
    config DUP_CHOICE_D
        bool "option d"
endchoice

config UNRELATED
    float "Unrelated symbol"
    default 1.1
```

## test/kconfiglib/kconfigs/Kconfig.multiple_value_set
```kconfig
mainmenu "Test if config options and choices set multiple times are loaded correctly"

    config CONTROL
        int "Control symbol set only once"
        default 1

    config MULTIPLE_DEFAULT
        string "Symbol with multiple default values"
        default "d1"

    config MULTIPLE_COMMON
        string "Symbol with multiple values, both user-set and default"
        default "c1"

    choice CHOICE_CONTROL
        prompt "Control choice"

        config ALPHA_CONTROL
            bool "alpha control"
        config BETA_CONTROL
            bool "beta control"
        config GAMMA_CONTROL
            bool "gamma control"

    endchoice

    choice CHOICE_DEFAULT
        prompt "Some choice symbols will have multiple default assignments"

        config ALPHA_DEFAULT
            bool "alpha default"
        config BETA_DEFAULT
            bool "beta default"
        config GAMMA_DEFAULT
            bool "gamma default"

    endchoice


    choice CHOICE_COMMON
        prompt "Some choice symbols will have multiple value assignments (both default and user-set)"

        config ALPHA_COMMON
            bool "alpha common"
        config BETA_COMMON
            bool "beta common"
        config GAMMA_COMMON
            bool "gamma common"

    endchoice


    choice CHOICE_SECOND_DEFAULT
        prompt "Similar to CHOICE_DEFAULT, but different assignment placement in sdkconfig"

        config ALPHA_SECOND_DEFAULT
            bool "alpha second default"
        config BETA_SECOND_DEFAULT
            bool "beta second default"
        config GAMMA_SECOND_DEFAULT
            bool "gamma second default"

    endchoice

    choice CHOICE_SECOND_COMMON
        prompt "Similar to CHOICE_COMMON, but different assignment placement in sdkconfig"

        config ALPHA_SECOND_COMMON
            bool "alpha second common"
        config BETA_SECOND_COMMON
            bool "beta second common"
        config GAMMA_SECOND_COMMON
            bool "gamma second common"

    endchoice
```

## test/kconfiglib/kconfigs/Kconfig.nested_choices
```kconfig
mainmenu "Test that nested choices do not leak data into each other"

choice OUTER
    prompt "Outer choice"

    config OUTER_A
        bool "Outer A"

    config OUTER_B
        bool "Outer B"

    # Note: this is de facto illegal and we support it only for compat reasons
    choice INNER
        prompt "Inner choice"

        config INNER_X
            bool "Inner X"

        config INNER_Y
            bool "Inner Y"

    endchoice

endchoice
```

## test/kconfiglib/kconfigs/Kconfig.promptless_user_value
```kconfig
mainmenu "Promptless Symbol Test"

    config PROMPTLESS_STRING
        string
        default "default_val"

    config PROMPTLESS_BOOL
        bool
        default y

    config NORMAL_DISABLED
        bool "Normal disabled symbol"
        depends on NONEXISTENT
        default n
```

## test/kconfiglib/kconfigs/Kconfig.string_escape
```kconfig
mainmenu "String escape round-trip"

config GREETING
    string "Greeting"
    default "he said \"hi\""

config WINPATH
    string "Path"
    default "C:\\tmp"
```

## test/menuconfig/kconfigs/Kconfig
```kconfig
mainmenu "Test kconfig"

    config MOTORS_ENABLED
        bool "Motors enabled"
        default n

    config CREW
        bool "Crew"
        default n

    config FUEL
        string "Fuel"
        default "kerosene"

    choice LUNCH
        prompt "Lunch"

        config LUNCH_SANDWICH
            bool "Sandwich"

        config LUNCH_PIZZA
            bool "Pizza"

        config LUNCH_SALAD
            bool "Salad"
    endchoice
```

## test/menuconfig/kconfigs/Kconfig.choice_explicit_default
```kconfig
# Named choice with explicit default (second symbol), not implicit first-symbol default
mainmenu "mainmenu"

    config A
        bool "a"
        default y
        help
            help for a

    comment "Named choice with explicit default BAR"

    choice NAMED_CHOICE
        prompt "prompt for named choice"
        default BAR

        config FOO
            bool "foo"
            help
                help for foo

        config BAR
            bool "bar"
            help
                help for bar

    endchoice

    comment "Unnamed choice"

    choice
        bool "unnamed choice"
        default BAZ
        help
            help for bool choice

        config BAZ
            bool "baz"
            help
                help for baz
            depends on A

        config QUX
            bool "qux"
            help
                help for qux

    endchoice
```
